#include "turbo.dtsi"  // include before keys.h so key-code names don't expand inside TURBO_KEY

#include <behaviors.dtsi>
#include <dt-bindings/zmk/keys.h>
#include <dt-bindings/zmk/bt.h>
#include <dt-bindings/zmk/rgb.h>
#include <dt-bindings/zmk/backlight.h>
#include <behaviors/num_word.dtsi>  // requires auto-layer module

#include "zmk-helpers/helper.h"

#define DEF 0     // dvorak (standard, daily driver)
#define DVOLD 1   // dvorak_old (legacy layout + gaming layers)

#define NAV 2
#define NUM 3
#define WOW 4
#define GAME 5
#define QWRTY 6
#define FNL 7   // F-keys, all on the left hand (double-tap + hold nav)

/*                                 ADVANTAGE 360 KEY MATRIX / LAYOUT MAPPING
 ╭────────────────────────────┬────────────────────────────╮ ╭────────────────────────────┬────────────────────────────╮
 │  0   1   2   3   4   5   6 │  7   8   9  10  11  12  13 │ │ LN5 LN4 LN3 LN2 LN1 LN0 -- │ --  RN0 RN1 RN2 RN3 RN4 RN5│
 │ 14  15  16  17  18  19  20 │ 21  22  23  24  25  26  27 │ │ LT5 LT4 LT3 LT2 LT1 LT0 -- │ --  RT0 RT1 RT2 RT3 RT4 RT5│
 │ 28  29  30  31  32  33  34 │ 35  36  37  38  39  40  41 │ │ LM5 LM4 LM3 LM2 LM1 LM0 -- │ --  RM0 RM1 RM2 RM3 RM4 RM5│
 │ 42  43  44  45  46  47 ╭───┴───╮ 48  49  50  51  52  53 │ │ LB5 LB4 LB3 LB2 LB1 LB0╭───┴───╮ RB0 RB1 RB2 RB3 RB4 RB5│
 │ 54  55  56  57  58╭────╯       ╰────╮59  60  61  62  63 │ │ --  --  --  --  --╭────╯       ╰────╮--  --  --  --  -- │
 ╰───────────────────┼────────┬────────┼───────────────────╯ ╰───────────────────┼────────┬────────┼───────────────────╯
                 ╭───╯ 64  65 │ 66  67 ╰───╮                                 ╭───╯ --  -- │ --  -- ╰───╮
                 │ 68  69  70 │ 71  72  73 │                                 │ LH1 LH0 -- │ --  RH0 RH1│
                 ╰───────╮ 74 │ 75 ╭───────╯                                 ╰───────╮ -- │ -- ╭───────╯
                         ╰────┴────╯                                                 ╰────┴────╯ */

#define LH0 65  // left thumb keys
#define LH1 66
#define RH0 69  // right thumb keys
#define RH1 70

#define LN0  5  // left-number row
#define LN1  4
#define LN2  3
#define LN3  2
#define LN4  1
#define LN5  0

#define RN0  8  // right-number row
#define RN1  9
#define RN2 10
#define RN3 11
#define RN4 12
#define RN5 13

#define LT0 19  // left-top row
#define LT1 18
#define LT2 17
#define LT3 16
#define LT4 15
#define LT5 14

#define RT0 22  // right-top row
#define RT1 23
#define RT2 24
#define RT3 25
#define RT4 26
#define RT5 27

#define LM0 33  // left-middle row
#define LM1 32
#define LM2 31
#define LM3 30
#define LM4 29
#define LM5 28

#define RM0 40  // right-middle row
#define RM1 41
#define RM2 42
#define RM3 43
#define RM4 44
#define RM5 45

#define LB0 51  // left-bottom row
#define LB1 50
#define LB2 49
#define LB3 48
#define LB4 47
#define LB5 46

#define RB0 54  // right-bottom row
#define RB1 55
#define RB2 56
#define RB3 57
#define RB4 58
#define RB5 59

#define KEYS_L LT0 LT1 LT2 LT3 LT4 LT5 LM0 LM1 LM2 LM3 LM4 LM5 LB0 LB1 LB2 LB3 LB4 LB5  // left hand
#define KEYS_R RT0 RT1 RT2 RT3 RT4 RT5 RM0 RM1 RM2 RM3 RM4 RM5 RB0 RB1 RB2 RB3 RB4 RB5  // right hand
#define THUMBS LH0 LH1 RH0 RH1                                                          // thumbs

#include "combos.dtsi"  // requires layer aliases
#include "mouse.dtsi"

#define XXX &none
#define ___ &trans

/* Global settings */

#define QUICK_TAP_MS 175

&sk {  // sticky-key config
    release-after-ms = <900>;  // release after 0.6s
    quick-release;             // no double capitalization when rolling keys
};

&sl {  // sticky-layer config
    ignore-modifiers;          // allow chording sticky mods & layers
};

&lt {  // layer-tap config
    flavor = "balanced";
    tapping-term-ms = <200>;
    quick-tap-ms = <QUICK_TAP_MS>;
};

/* Homerow mods */

#define MAKE_HRM(NAME, HOLD, TAP, TRIGGER_POS) \
    ZMK_HOLD_TAP(NAME, \
        flavor = "balanced"; \
        tapping-term-ms = <280>; \
        quick-tap-ms = <QUICK_TAP_MS>; \
        require-prior-idle-ms = <150>; \
        bindings = <HOLD>, <TAP>; \
        hold-trigger-key-positions = <TRIGGER_POS>; \
        hold-trigger-on-release; \
        display-name = ZMK_HELPER_STRINGIFY(NAME); \
    )
MAKE_HRM(hml, &kp, &kp, KEYS_R THUMBS)  // left-hand HRMs
MAKE_HRM(hmr, &kp, &kp, KEYS_L THUMBS)  // right-hand HRMs


/* Nav cluster */

// long-tap action on hold, short-tap action on all interrupts
#define MT_CORE \
    flavor = "tap-preferred"; \
    tapping-term-ms = <220>; \
    quick-tap-ms = <220>; \
    hold-trigger-key-positions = <0>;

&mt { MT_CORE };
ZMK_HOLD_TAP(mt_home, bindings = <&masked_home>, <&kp>; MT_CORE display-name = "Home";)
ZMK_HOLD_TAP(mt_end, bindings = <&masked_end>, <&kp>; MT_CORE display-name = "End";)

// mask CTRL when holding left/right to avoid accidental jumps to beginning/end of document
#define MASK_MODS(NAME, MODS, BINDING) \
    ZMK_MOD_MORPH(NAME, \
        bindings = <BINDING>, <BINDING>; \
        mods = <MODS>; \
        display-name = ZMK_HELPER_STRINGIFY(NAME); \
    )
MASK_MODS(masked_home, (MOD_LCTL), &kp HOME)
MASK_MODS(masked_end,  (MOD_LCTL), &kp END)

/* Caps-word, num-word and smart-mouse */

// tap: sticky-shift | shift + tap/ double-tap: caps-word | hold: shift
ZMK_MOD_MORPH(smart_shft,
    bindings = <&sk LSHFT>, <&caps_word>;
    mods = <(MOD_LSFT)>;
    display-name = "Shift";
)
&caps_word {  // mods deactivate caps-word, requires PR #1451
    /delete-property/ ignore-modifiers;
};

// tap: num-word | double-tap: sticky num-layer | hold: num-layer
#define SMART_NUM &smart_num NUM 0
ZMK_HOLD_TAP(smart_num,
    flavor = "balanced";
    tapping-term-ms = <200>;
    quick-tap-ms = <QUICK_TAP_MS>;
    bindings = <&mo>, <&num_dance>;
    display-name = "Num";
)

ZMK_TAP_DANCE(num_dance,
    tapping-term-ms = <200>;
    bindings = <&num_word NUM>, <&sl NUM>;  // reverse this for sticky-num on single tap
    display-name = "Num";
)

// hold: nav layer | double-tap + hold: F-key layer (all F-keys under the left hand)
#define SMART_NAV &smart_nav NAV 0
ZMK_HOLD_TAP(smart_nav,
    flavor = "hold-preferred";
    tapping-term-ms = <200>;
    quick-tap-ms = <200>;
    bindings = <&mo>, <&nav_dance>;
    display-name = "Nav";
)

// first tap is a no-op (a bare nav tap never did anything), second press holds the F-key layer
ZMK_TAP_DANCE(nav_dance,
    tapping-term-ms = <200>;
    bindings = <&none>, <&mo FNL>;
    display-name = "Nav";
)

ZMK_TAP_DANCE(game_toggle,
    tapping-term-ms = <200>;
    bindings = <&to WOW>, <&to GAME>;
    display-name = "Game";
)

ZMK_TAP_DANCE(mute_pp,
    tapping-term-ms = <200>;
    bindings = <&kp C_PP>, <&kp C_MUTE>;
    display-name = "Play/Mute";
)

// reuse basic mod-morph scheme
#define SIMPLE_MORPH(NAME, MOD, BINDING1, BINDING2) \
    ZMK_MOD_MORPH(NAME, \
        mods = <(MOD_L ## MOD|MOD_R ## MOD)>; \
        bindings = <BINDING1>, <BINDING2>; \
        display-name = ZMK_HELPER_STRINGIFY(NAME); \
    )

SIMPLE_MORPH(tilde, SFT, &kp TILDE, &kp GRAVE)
SIMPLE_MORPH(pipe, SFT, &kp PIPE, &kp BSLH)

SIMPLE_MORPH(l_brace, SFT, &kp LBRC, &kp LBKT)
SIMPLE_MORPH(r_brace, SFT, &kp RBRC, &kp RBKT)

SIMPLE_MORPH(l_paran, SFT, &kp LPAR, &kp LT)
SIMPLE_MORPH(r_paran, SFT, &kp RPAR, &kp GT)

SIMPLE_MORPH(l_bkt, SFT, &kp LT, &kp LBKT)
SIMPLE_MORPH(r_bkt, SFT, &kp GT, &kp RBKT)

SIMPLE_MORPH(under_dash, SFT, &kp UNDER, &kp MINUS)

SIMPLE_MORPH(qexcl, SFT, &kp QMARK, &kp EXCL)
SIMPLE_MORPH(quote_dbl, SFT, &kp DQT, &kp SQT)

SIMPLE_MORPH(semi_comma, SFT, &kp SEMI, &kp COMMA)
SIMPLE_MORPH(colon_period, SFT, &kp PERIOD,&kp COLON )

SIMPLE_MORPH(tilde_grave, SFT, &kp TILDE, &kp GRAVE)

SIMPLE_MORPH(bspc_delete, SFT, &kp BSPC, &kp DEL)

// tap: space | shift + tap: dot -> space -> sticky shift | hold: activate layer
ZMK_HOLD_TAP(lt_spc,
    flavor = "balanced";
    tapping-term-ms = <200>;
    quick-tap-ms = <QUICK_TAP_MS>;
    bindings = <&mo>, <&spc_morph>;
    display-name = "Space";
)

ZMK_HOLD_TAP(lt_bspc,
    flavor = "balanced";
    tapping-term-ms = <200>;
    quick-tap-ms = <QUICK_TAP_MS>;
    bindings = <&mo>, <&bspc_delete>;
    display-name = "Bspc";
)

SIMPLE_MORPH(spc_morph, SFT, &kp SPACE, &kp ESCAPE)

SIMPLE_MORPH(bad_paste, CTL, &kp V, &none)
SIMPLE_MORPH(bad_copy, CTL, &kp C, &none)
SIMPLE_MORPH(bad_undo, CTL, &kp Z, &none)
SIMPLE_MORPH(bad_tab_close, CTL, &kp W, &none)


ZMK_MACRO(dot_spc,
    wait-ms = <0>;
    tap-ms = <5>;
    bindings = <&kp DOT &kp SPACE &sk LSHFT>;
    display-name = ". Spc Shft";
)

// tap: copy | double-tap: cut
ZMK_TAP_DANCE(copy_cut,
    tapping-term-ms = <200>;
    bindings = <&kp LC(C)>, <&kp LC(X)>;
    display-name = "Copy/Cut";
)

ZMK_TAP_DANCE(screen_shot,
    tapping-term-ms = <200>;
    bindings = <&kp PSCRN>, <&kp LS(PSCRN)>;
    display-name = "PrtSc";
)

// Windows sleep key
ZMK_MACRO(win_sleep,
    wait-ms = <500>;
    tap-ms = <50>;
    bindings = <&kp LG(X) &kp U &kp S>;
    display-name = "Sleep";
)

// Alt+Tab swapper, requires PR #1366
ZMK_TRI_STATE(swapper,
    bindings = <&kt LALT>, <&kp TAB>, <&kt LALT>;
    ignored-key-positions = <LT2>;
    display-name = "AltTab";
)

// misc aliases
#define CANCEL      &kp K_CANCEL             // cancel caps-word, num-word and smart-mouse

/* ADV360-specific behaviors and combos */

/ {
    behaviors {
        td_bt1: tap_dance_bt1 {
            compatible = "zmk,behavior-tap-dance";
            #binding-cells = <0>;
            tapping-term-ms = <200>;
            bindings = <&none>, <&bt BT_SEL 1>;
            display-name = "BT 1";
        };

        td_disc: tap_dance_disc {
            compatible = "zmk,behavior-tap-dance";
            #binding-cells = <0>;
            tapping-term-ms = <200>;
            bindings = <&kp LC(LS(M))>, <&kp LC(LS(D))> ;
            display-name = "BT 1";
        };


        td_bt2: tap_dance_bt2 {
            compatible = "zmk,behavior-tap-dance";
            #binding-cells = <0>;
            tapping-term-ms = <200>;
            bindings = <&none>, <&bt BT_SEL 2>;
            display-name = "BT 2";
        };

        td_dictate: td_dictate {
            compatible = "zmk,behavior-tap-dance";
            #binding-cells = <0>;
            tapping-term-ms = <200>;
            bindings = <&kp LG(D)>, <&kp LG(LA(D))>;
            display-name = "Dictate";
        };

        td_dictate2: td_dictate2 {
            compatible = "zmk,behavior-tap-dance";
            #binding-cells = <0>;
            tapping-term-ms = <200>;
            bindings = <&kp F11>, <&kp LG(F11)>;
            display-name = "Dictate2";
        };
    };

    combos {
        compatible = "zmk,combos";
        combo_bt_reset {
            timeout-ms = <30>;
            key-positions = <64 65>;
            bindings = <&bt BT_CLR>;
        };
    };
};

/* Keymap */
/*
*
*
#define QWERTY 0
#define FN2 1
#define WOW2 2
#define DVRK 3
#define NAV 4
#define NUM 5https://www.archon.gg/wow/builds/devourer/demon-hunter/mythic-plus/gear-and-tier-set/high-keys/all-dungeons/this-week
#define FN 6
#define SYMBOL 7
#define WOW 8
#define GAME 9
* */


/*
*
SIMPLE_MORPH(quote_dbl, SFT, &kp DQT, &kp SQT)
SIMPLE_MORPH(semi_comma, SFT, &kp SEMI, &kp COMMA)
SIMPLE_MORPH(colon_period, SFT, &kp PERIOD,&kp COLON )
' "



o
*/


ZMK_LAYER(dvorak,
    &kp GRAVE  &kp N1         &kp N2         &kp N3         &kp N4         &kp N5         &kp F12                                                                    &kp C_VOL_UP   &kp N6         &kp N7         &kp N8         &kp N9         &kp N0         &none
    &kp TAB    &kp APOS       &kp COMMA      &kp DOT        &kp P          &kp Y          &kp F6                                                                     &kp C_VOL_DN   &kp F          &kp G          &kp C          &kp R          &kp L          &none
    &kp ESCAPE &kp A          &kp O          &kp E          &kp U          &kp I          &kp F5         &td_dictate    &td_dictate2        &td_disc   &kp F10       &mute_pp      &kp D          &kp H          &kp T          &kp N          &kp S          &kp RETURN
    &kp LSHFT  &kp SEMI       &kp Q          &kp J          &kp K          &kp X                                        &kp DEL         &to QWRTY                                   &kp B          &kp M          &kp W          &kp V          &kp Z           &kp SLASH
    &kp LCTRL  &kp UP         &kp DOWN       &kp LWIN       &kp LALT                      &kp SPACE      &kp BSPC       SMART_NAV       SMART_NUM          SMART_NAV                  &kp LWIN       &kp LEFT          &kp RIGHT          &none          &none           &none
)


ZMK_LAYER(dvorak_old,
    &kp GRAVE  &kp N1         &kp N2         &kp N3         &kp N4         &kp N5         &kp F12                                                                            ___    &kp N6         &kp N7         &kp N8         &kp N9         &kp N0         &none
    &kp TAB    &quote_dbl     &semi_comma    &colon_period  &kp P          &kp Y          &kp F6                                                                             ___    &kp F          &kp G          &kp C          &kp R          &kp L          &none
    &kp ESCAPE &kp A          &kp O          &kp E          &kp U          &kp I          &kp F5       &kp LC(PRINTSCREEN)  &kp SPACE  &bt BT_SEL 0   &td_bt1                ___    &kp D          &kp H          &kp T          &kp N          &kp S    &kp RETURN
    &kp LSHFT  &kp SLASH      &kp Q          &kp J          &kp K          &kp X                                        &to DEF        &to QWRTY                                    &kp B          &kp M          &kp W          &kp V          &kp Z          &none
    &kp LCTRL  &kp UP         &kp DOWN       &kp LWIN       &kp LALT                      &lt NAV SPACE   &lt_bspc NAV BSPC &game_toggle &none         &mo NAV       &kp LWIN       &none          &none          &none          &none          &none
)
ZMK_LAYER(fn,
    &kp F1     &kp F2         &kp F3         &kp F4         &kp F5         &kp F6         &kp F7                                                                              ___            &kp F7         &kp F8         &kp F9         &kp F10        &kp F11        &kp F12
    ___        &kp LG(GRAVE)   &kp LC(LS(TAB)) &kp LC(TAB)   &kp LC(W)      &kp LC(LS(L))  &kp F8                                                                              ___            &tilde_grave   &kp MINUS      &kp EQUAL      &kp UNDER      &kp PLUS       ___
    &kp HOME   &kp LEFT       &kp DOWN       &kp UP         &kp RIGHT      &kp END        &kp F9           &bt BT_CLR     &bt BT_NXT     &td_bt2        ___  ___    &kp PIPE       &kp LPAR       &l_bkt         &kp LBRC       &kp PG_UP      ___
    ___        &kp LC(Z)      &kp LC(A)      &copy_cut      &kp LC(V)      &screen_shot                                ___             &to DVOLD                           &kp BSLH       &kp RPAR       &r_bkt         &kp RBRC       &kp PG_DN      ___
    ___        ___          ___          ___          ___                  ___            ___        ___            ___                    ___            ___            ___            ___            ___            ___            ___
)

ZMK_LAYER(num,
    ___      ___        ___        ___        ___        ___        &none                                                                              ___   ___        ___        ___        ___        ___        ___
    ___        ___            ___            ___            ___            ___            &none                                                                              ___            ___            &kp N7         &kp N8         &kp N9         ___            &none
    &kp ESCAPE ___            ___            ___           ___           ___            &none           &bt BT_CLR_ALL   &td_bt1        &td_bt2        ___  &mute_pp  ___            &kp N4         &kp N5         &kp N6         &kp N0         ___
    ___        ___            ___            ___            ___            ___                                           &kp LG(LA(D))  ___                          ___            &kp N1         &kp N2         &kp N3         ___            ___
    ___        &none          &none          &none          &kp C_VOL_DN                  ___            ___            ___          SMART_NUM                   ___        ___            ___            ___            ___            ___            ___
)



ZMK_LAYER(wow,
    &kp GRAVE  TK(N1)      TK(N2)      &kp N3         TK(N4)      TK(N5)      TK(F12)                                                                       &kp LS(F11)         &kp N6         &kp N7         &kp N8         &kp N9         &kp N0         ___
    &kp TAB    TK(SQT)   TK(COMMA) &kp PERIOD    TK(P)          TK(Y)          TK(F6)                                                                        &kp LC(F10)        &kp F          &kp G          &kp C          &kp R          &kp L          &kp SEMI
    &kp ESC    TK(A)         &kp O          &kp E          &kp U          TK(I)         TK(F5)        &kp LALT       &td_disc    ___            ___                   &kp LA(F11)        &kp D          &hmr LSHFT H   &hmr LCTRL T   &hmr LGUI N    &hmr LALT S    &kp ENTER
    &kp LSHFT  TK(SLASH) TK(Q)       TK(J)         TK(K)         TK(X)                                        &kp DEL        &kp PRINTSCREEN                      &kp B          &kp M          &kp W          &kp V          &kp Z          ___
    &kp LCTRL  &kp UP         &kp DOWN       &kp LBKT       &kp N9                        &kp SPACE      TK(BSPC) &to DEF        ___            ___            ___    ___            &none          ___            ___            ___

)

ZMK_LAYER(game,
    &kp GRAVE  &kp N1         &kp N2         &kp N3         &kp N4         &kp N5         &kp F12                                                                            &kp LS(F11)         &kp N6         &kp N7         &kp N8         &kp N9         &kp N0         ___
    &kp TAB    &kp SQT        &kp COMMA      &kp PERIOD     &kp P          &kp Y          &kp F6                                                                             &kp LC(F10)        &kp F          &kp G          &kp C          &kp R          &kp L          &kp SEMI
    &kp ESC    &kp A          &kp O          &kp E          &kp U          &kp I          &kp F5          &kp LALT       &td_disc       ___            ___                   &kp LA(F11)        &kp D          &kp H          &kp T          &kp N          &kp S          &kp ENTER
    &kp LSHFT  &kp SLASH      &kp Q          &kp J          &kp K          &kp X                                         &kp DEL        &kp PRINTSCREEN                                     &kp B          &kp M          &kp W          &kp V          &kp Z          ___
    &kp LCTRL  &kp UP         &kp DOWN       &kp LBKT       &kp N9                        &kp SPACE      &kp BSPC       &to DEF         ___            ___            ___    ___            &none          ___            ___            ___
)
//set colorcolumn=15,30,45,60,75,90,105,120,134,135,150,165,180,195,210,225,240,255


ZMK_LAYER(qwerty,
    &kp GRAVE  &kp N1         &kp N2         &kp N3         &kp N4         &kp N5         &kp F12                                                                    &kp C_VOL_UP   &kp N6         &kp N7         &kp N8         &kp N9         &kp N0         &kp MINUS
    &kp TAB    &kp Q          &kp W          &kp E          &kp R          &kp T          &kp F6                                                                     &kp C_VOL_DN   &kp Y          &kp U          &kp I          &kp O          &kp P          &kp BSLH
    &kp ESCAPE &kp A          &kp S          &kp D          &kp F          &kp G          &kp F5         ___            ___            ___            ___            &mute_pp       &kp H          &kp J          &kp K          &kp L          &kp SEMI       &kp ENTER
    &kp LSHFT  &kp Z          &kp X          &kp C          &kp V          &kp B                                        ___            &to DEF                                      &kp N          &kp M          &kp COMMA      &kp DOT        &kp FSLH       &kp APOS
    &kp LCTRL  &kp LEFT           &kp RIGHT            &kp LWIN       &kp LALT                      &kp SPACE      &kp BSPC       &mo NAV         ___            &mo NAV        &kp LWIN                      &kp UP            &kp DOWN            &kp LBKT       &kp RBKT       &kp EQUAL
  )




// all F-keys under the left hand, numpad-style:  F12 F7 F8 F9 / F11 F4 F5 F6 / F10 F1 F2 F3
ZMK_LAYER(fnl,
    ___        ___            ___            ___            ___            ___            ___                                                                       ___            ___            ___            ___            ___            ___            ___
    ___        &kp F12        &kp F7         &kp F8         &kp F9         ___   ___                                                                        ___            ___            ___            ___            ___            ___            ___
    ___        &kp F11        &kp F4         &kp F5         &kp F6         ___   ___            ___            ___            ___            ___            ___            ___            ___            ___            ___            ___            ___
    ___        &kp F10        &kp F1         &kp F2         &kp F3         ___                                 ___            ___                                         ___            ___            ___            ___            ___            ___
    ___        ___            ___            ___            ___                          ___             ___            ___            ___            ___           ___            ___            ___            ___            ___            ___
)
