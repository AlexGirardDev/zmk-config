/* source key position labels */
#include "zmk-helpers/key-labels/42.h"

/* map Corne's extra keys */
#define X_LT  &kp TAB

#define FN_LM  &kp HOME
#define X_LM    &kp ESCAPE


#define X_LH  &none //left thumb cluster

#define X_RT  &none
#define X_RM  &kp RETURN

#define X_LB  &kp TAB
/* #define X_LH  &kp ESC    // thumb row, left */

#define X_RB  &kp RETURN
#define X_RH  SMART_NUM      // thumb row, right

/* source the main keymap */
#include "base.keymap"
