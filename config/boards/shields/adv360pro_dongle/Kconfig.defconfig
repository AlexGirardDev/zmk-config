## config/boards/shields/adv360pro_dongle/Kconfig.shield
```kconfig
# Copyright (c) 2026 Alex Girard
# SPDX-License-Identifier: MIT

config SHIELD_ADV360PRO_DONGLE
    def_bool $(shields_list_contains,adv360pro_dongle)
```

## config/boards/shields/handwired65/Kconfig.defconfig
```kconfig
# Copyright (c) 2024 Alex Girard
# SPDX-License-Identifier: MIT

if SHIELD_HANDWIRED65

config ZMK_KEYBOARD_NAME
    default "Handwired 65"

endif
```

## config/boards/shields/handwired65/Kconfig.shield
```kconfig
# Copyright (c) 2024 Alex Girard
# SPDX-License-Identifier: MIT

config SHIELD_HANDWIRED65
    def_bool $(shields_list_contains,handwired65)
```
