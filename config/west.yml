## config/west.yml
```yaml
# This file specifies the build dependencies for Github Action workflows and
# for local build environments. The workspace has four toplevel directories
# containing the user config, modules, zephy and ZMK.
#
# ZMK-Workspace
# ├── config
# ├── modules
# ├── zephyr
# └── zmk
#
# To create a local build environment, clone this repository and then run the
# following commands from its toplevel directory:
#
# $ west init -l config
# $ west update
# $ west zephyr-export
#
---
manifest:
  defaults:
    remote: urob
    revision: v0.2 # Pin everything to v0.2

  remotes:
    - name: urob
      url-base: https://github.com/urob
    # - name: alex
    #   url-base: https://github.com/alexgirarddev
    - name: zmkfirmware
      url-base: https://github.com/zmkfirmware
    - name: local_git # You can name this remote anything descriptive
      # Use file:// followed by the ABSOLUTE path to the PARENT directory
      url-base: file:///home/alex/git

  projects:
    - name: zmk
      remote: zmkfirmware
      import: app/west.yml

    # ZMK modules
    - name: zmk-adaptive-key
      path: modules/zmk/adaptive-key
    - name: zmk-auto-layer
      path: modules/zmk/auto-layer
    - name: zmk-helpers
      path: modules/zmk/helpers
    - name: zmk-leader-key
      path: modules/zmk/leader-key
    - name: zmk-tri-state
      path: modules/zmk/tri-state

    - name: zmk-behavior-turbo-key # This MUST match the actual directory name
      remote: local_git            # Use the remote defined above
      revision: og               # Or your specific branch/tag
      # Path where west will place this module INSIDE your workspace
      path: modules/local/zmk-behavior-turbo-key


    # - name: zmk-behavior-key-tempo # This MUST match the actual directory name
    #   remote: local_git            # Use the remote defined above
    #   revision: main               # Or your specific branch/tag
    #   # Path where west will place this module INSIDE your workspace
    #   path: modules/local/zmk-behavior-key-tempo

    # Temporarily overload Zephyr until
    # https://github.com/zmkfirmware/zephyr/pull/40 is merged.
    - name: zephyr
      revision: v3.5.0+zmk-fixes
      clone-depth: 1
      import:
        # Only enable most commonly used boards. For less common hardware one
        # may need to enable additional modules.
        name-allowlist:
          - cmsis
          - hal_nordic
          - hal_rpi_pico
          - hal_stm32
          - lvgl
          - tinycrypt

  self:
    path: config
```
